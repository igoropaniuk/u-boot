## configs/poplar_defconfig
```kconfig
CONFIG_ARM=y
CONFIG_TARGET_POPLAR=y
CONFIG_SYS_TEXT_BASE=0x37000000
CONFIG_IDENT_STRING="poplar"
CONFIG_DISTRO_DEFAULTS=y
CONFIG_NR_DRAM_BANKS=2
# CONFIG_DISPLAY_CPUINFO is not set
CONFIG_SYS_PROMPT="poplar# "
CONFIG_CMD_MMC=y
CONFIG_CMD_USB=y
# CONFIG_ISO_PARTITION is not set
CONFIG_DEFAULT_DEVICE_TREE="hi3798cv200-poplar"
CONFIG_ENV_IS_IN_MMC=y
CONFIG_MMC_DW=y
CONFIG_MMC_DW_K3=y
CONFIG_NETDEVICES=y
CONFIG_NET_HIGMACV300=y
CONFIG_USB=y
CONFIG_USB_EHCI_HCD=y
CONFIG_USB_EHCI_GENERIC=y
CONFIG_USB_STORAGE=y
CONFIG_USB_HOST_ETHER=y
CONFIG_USB_ETHER_ASIX=y
CONFIG_FAT_WRITE=y
CONFIG_RANDOM_UUID=y

CONFIG_RANDOM_UUID=y
CONFIG_TEE=y
CONFIG_OPTEE=y
CONFIG_TEE_CLIENT_API=y
CONFIG_SUPPORT_EMMC_RPMB=y
CONFIG_OPTEE_TA_AVB=y
CONFIG_LIBAVB=y
CONFIG_FASTBOOT=y
CONFIG_AVB_VERIFY=y
CONFIG_CMD_AVB=y
CONFIG_ANDROID_BOOT_IMAGE=y
CONFIG_FASTBOOT_BUF_ADDR=0x08000000
CONFIG_FASTBOOT_BUF_SIZE=0x2000000
CONFIG_PARTITION_UUIDS=y
CONFIG_UDP_FUNCTION_FASTBOOT=y
```

## lib/optee-client/Kconfig
```kconfig
config OPTEE_CLIENT
	bool "OPTEE portable client"
	help
	  Some description here
```
