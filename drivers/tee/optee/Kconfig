## drivers/tee/optee/Kconfig
```kconfig
# OP-TEE Trusted Execution Environment Configuration
config OPTEE
	bool "OP-TEE"
	depends on ARM_SMCCC
	help
	  This implements the OP-TEE Trusted Execution Environment (TEE)
	  driver. OP-TEE is a Trusted OS designed primarily to rely on the
	  ARM TrustZone(R) technology as the underlying hardware isolation
	  mechanism. This driver can request services from OP-TEE, but also
	  handle Remote Procedure Calls (RPC) from OP-TEE needed to
	  execute a service. For more information see: https://www.op-tee.org

if OPTEE || SANDBOX

menu "OP-TEE options"

config OPTEE_TA_AVB
	bool "Support AVB TA"
	default y
	help
	  Enables support for the AVB Trusted Application (TA) in OP-TEE.
	  The TA can support the "avb" subcommands "read_rb", "write_rb"
	  and "is_unlocked".

config OPTEE_TA_RPC_TEST
	bool "Support RPC TEST TA"
	depends on SANDBOX_TEE
	default y
	help
	  Enables support for RPC test trusted application emulation, which
	  permits to test reverse RPC calls to TEE supplicant. Should
	  be used only in sandbox env.

config OPTEE_TA_SCP03
	bool "Support SCP03 TA"
	default y
	help
	  Enables support for controlling (enabling, provisioning) the
	  Secure Channel Protocol 03 operation in the OP-TEE SCP03 TA.

config OPTEE_LOAD_TA
	bool "Load Trusted Applications on request from OP-TEE"
	help
	  Handle the OPTEE_MSG_RPC_CMD_LOAD_TA request from OP-TEE, which is
	  issued when a session is opened to a Trusted Application (TA) that
	  is not built into the OP-TEE image as an early TA. This is the part
	  of the Linux tee-supplicant that locates TA binaries.

	  U-Boot only supplies the TA binary. OP-TEE verifies its signature
	  before loading it, so the storage the TA is read from does not need
	  to be trusted. Secure storage on the normal world filesystem (REE
	  FS) is not provided; TAs that need persistent storage must use RPMB,
	  and OP-TEE must keep its TA version database there as well
	  (CFG_TA_VERSION_DB_RPMB=y), see doc/README.tee.

if OPTEE_LOAD_TA

config OPTEE_LOAD_TA_FIT
	bool "Look up TAs in a FIT image in memory"
	depends on FIT
	help
	  Look for TAs in a FIT image already present in memory. The address
	  of the FIT image is read from the "optee_ta_fit" environment
	  variable. Each TA is a sub-image under /images whose node name is
	  the UUID of the TA in standard textual form, for example
	  "8aaaf200-2450-11e4-abe2-0002a5d5c51b". Hashes and signatures
	  attached to the sub-image are verified before the TA is handed to
	  OP-TEE.

config OPTEE_LOAD_TA_FS
	bool "Look up TAs in a filesystem"
	default y
	help
	  Look for TAs as "<uuid>.ta" files in a directory on a block device,
	  the same layout that the Linux tee-supplicant uses in
	  /lib/optee_armtz. The device and directory default to the values
	  of the OPTEE_LOAD_TA_FS_* options below and can be overridden at
	  runtime with the "optee_ta_fs_iface", "optee_ta_fs_dev_part" and
	  "optee_ta_fs_dir" environment variables.

config OPTEE_LOAD_TA_FS_IFACE
	string "Block device interface holding the TAs"
	default "mmc"
	help
	  Interface name as used by the "load" command, for example "mmc",
	  "usb" or "virtio".

config OPTEE_LOAD_TA_FS_DEV_PART
	string "Device and partition holding the TAs"
	default "0:1"
	help
	  Device number and partition as used by the "load" command, for
	  example "0:1".

config OPTEE_LOAD_TA_FS_DIR
	string "Directory holding the TAs"
	default "/lib/optee_armtz"

endif

config OPTEE_SERVICE_DISCOVERY
	bool "OP-TEE service discovery"
	default y
	help
	  This implements automated driver binding of OP-TEE service drivers by
	  requesting OP-TEE firmware to enumerate its hosted services.

endmenu

endif
```
